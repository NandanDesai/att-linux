## security/att/Kconfig
```kconfig
config SECURITY_ATT
    bool "ATT early security module"
    depends on SECURITY
    default y
    help
      Enable the ATT LSM.

# KUnit tests for the ATT LSM
source "security/att/tests/Kconfig"
```

## security/att/kunit/Kconfig
```kconfig
config ATT_KUNIT_TEST
    tristate "KUnit tests for att LSM"
    depends on KUNIT
    default n
    help
      Enable unit tests for the att security module.
```
